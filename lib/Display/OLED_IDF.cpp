#include "OLED_IDF.h"
#include "freertos/FreeRTOS.h"
#include "freertos/task.h"

// Font ASCII 5x7
static const uint8_t font5x7[][5] = {
    {0x00,0x00,0x00,0x00,0x00}, {0x00,0x00,0x5f,0x00,0x00}, {0x00,0x07,0x00,0x07,0x00}, {0x14,0x7f,0x14,0x7f,0x14},
    {0x24,0x2a,0x7f,0x2a,0x12}, {0x23,0x13,0x08,0x64,0x62}, {0x36,0x49,0x55,0x22,0x50}, {0x00,0x05,0x03,0x00,0x00},
    {0x00,0x1c,0x22,0x41,0x00}, {0x00,0x41,0x22,0x1c,0x00}, {0x14,0x08,0x3e,0x08,0x14}, {0x08,0x08,0x3e,0x08,0x08},
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    {0x00,0x00,0x7f,0x00,0x00}, {0x00,0x41,0x36,0x08,0x00}, {0x10,0x08,0x08,0x10,0x08}
};
OLED_IDF::OLED_IDF(i2c_port_t port, gpio_num_t sda, gpio_num_t scl, uint8_t addr)
    : i2c_port(port), address(addr), sda_pin(sda), scl_pin(scl), cursor_x(0), cursor_y(0) {
    memset(buffer, 0, sizeof(buffer));
}

void OLED_IDF::sendCommand(uint8_t cmd) {
    uint8_t data[2] = {0x00, cmd};
    i2c_master_write_to_device(i2c_port, address, data, 2, pdMS_TO_TICKS(10));
}

bool OLED_IDF::init() {
    i2c_config_t conf = {};
    conf.mode = I2C_MODE_MASTER;
    conf.sda_io_num = sda_pin;
    conf.scl_io_num = scl_pin;
    conf.sda_pullup_en = GPIO_PULLUP_ENABLE;
    conf.scl_pullup_en = GPIO_PULLUP_ENABLE;
    conf.master.clk_speed = 400000;
    conf.clk_flags = 0;

    i2c_param_config(i2c_port, &conf);
    i2c_driver_install(i2c_port, conf.mode, 0, 0, 0);

    sendCommand(0xAE); 
    sendCommand(0x20); sendCommand(0x00); 
    sendCommand(0xB0); 
    sendCommand(0xC8); 
    sendCommand(0x00); 
    sendCommand(0x10); 
    sendCommand(0x40); 
    sendCommand(0x81); sendCommand(0xFF); 
    sendCommand(0xA1); 
    sendCommand(0xA6); 
    sendCommand(0xA8); sendCommand(0x3F); 
    sendCommand(0xA4); 
    sendCommand(0xD3); sendCommand(0x00); 
    sendCommand(0xD5); sendCommand(0x80); 
    sendCommand(0xD9); sendCommand(0x22); 
    sendCommand(0xDA); sendCommand(0x12); 
    sendCommand(0xDB); sendCommand(0x20); 
    sendCommand(0x8D); sendCommand(0x14); 
    sendCommand(0xAF); 

    clear();
    display();
    return true;
}

void OLED_IDF::clear() {
    memset(buffer, 0, sizeof(buffer));
    cursor_x = 0; cursor_y = 0;
}

void OLED_IDF::display() {
    sendCommand(0x20); sendCommand(0x02); 

    for (uint8_t page = 0; page < 8; page++) {
        sendCommand(0xB0 + page);
        sendCommand(0x00);
        sendCommand(0x10);
        
        uint8_t temp[129];
        temp[0] = 0x40;
        memcpy(&temp[1], &buffer[page * 128], 128);
        
        i2c_master_write_to_device(i2c_port, address, temp, 129, pdMS_TO_TICKS(50));
    }
}

void OLED_IDF::drawPixel(int16_t x, int16_t y, bool white) {
    if ((x >= 0) && (x < 128) && (y >= 0) && (y < 64)) {
        if (white) buffer[x + (y / 8) * 128] |=  (1 << (y & 7));
        else       buffer[x + (y / 8) * 128] &= ~(1 << (y & 7));
    }
}

void OLED_IDF::setCursor(uint8_t x, uint8_t y) {
    cursor_x = x;
    cursor_y = y;
}

void OLED_IDF::writeChar(char c) {
    if (c < 32 || c > 126) c = '?';
    
    for (uint8_t i = 0; i < 6; i++) {
        for (uint8_t j = 0; j < 8; j++) {
            drawPixel(cursor_x + i, cursor_y + j, false);
        }
    }

    for (uint8_t i = 0; i < 5; i++) {
        uint8_t line = font5x7[c - 32][i];
        for (uint8_t j = 0; j < 8; j++) {
            if (line & 0x01) drawPixel(cursor_x + i, cursor_y + j, true);
            line >>= 1;
        }
    }
    cursor_x += 6; 
}

void OLED_IDF::print(const char* str) {
    while (*str) {
        if (*str == '\n') {
            cursor_y += 10;
            cursor_x = 0;
        } else {
            writeChar(*str);
        }
        str++;
    }
}

void OLED_IDF::print(int val) {
    char buf[16];
    snprintf(buf, sizeof(buf), "%d", val);
    print(buf);
}

void OLED_IDF::print(float val, int width, int precision) {
    char buf[16];
    snprintf(buf, sizeof(buf), "%*.*f", width, precision, val);
    print(buf);
}